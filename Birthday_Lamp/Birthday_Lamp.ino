/*
  =================================================================================
                              | 什么是生日灯? |
  ---------------------------------------------------------------------------------
  做个生日灯，每次你过生日时，都会伴随着音乐和灯光。
  虽然只是一小步，但是离你接下来想要的东西更近了一点，这种感觉不是很好吗？

  =================================================================================
                                    | 开始 |
  ---------------------------------------------------------------------------------
  用传感器和一些声光效果把日常事物变得更有趣。
  =================================================================================
                            | 自己动手修改代码! |
  ---------------------------------------------------------------------------------
  点开 userDef.h 文件，然后根据你自己的喜好更改下面的参数。 :)

  BRIGHT_MAX: LED彩灯显示的最大亮度。

  当关闭音乐时，可以修改呼吸灯的颜色：ledBreath(COLOR_BLUE, 15)。

  修改完这些值后，记得再把代码上传到核心里。
  =================================================================================
                               |头脑风暴|
  ---------------------------------------------------------------------------------
  1. 可以再加一个投币口/灰度传感器吗?
     一个用来投一元硬币，另一个用来投一角和五角的硬币。
  2. 能否把代码改成当攒够一定量的钱时播放某一首特别的音乐吗？
  3. 可以给存钱罐加上一个电机吗?
     你是怎样想到的！听到硬币叮叮当当的响声一定很酷！

    注意: 以上功能上的变动会涉及到程序上的改动。
  =================================================================================
                                | 端口连接|
  ---------------------------------------------------------------------------------
  ColorLED:   D4
  蜂鸣器:      D8
  碰撞开关:    D6
  =================================================================================
                                   |问题 |
  ---------------------------------------------------------------------------------
  欢迎访问 http://forum.microduino.cn/，在我们的论坛提交您的问题， 我们会尽快回复您。
*/
#include <Microduino_Key.h>
#include <Microduino_ColorLED.h> //引用彩灯库
#include "userDef.h"

DigitalKey keyCoin(PIN_KEY);
ColorLED strip = ColorLED(LED_NUM, PIN_LED); //将ColorLED类命名为strip，并定义彩灯数量和彩灯引脚号

#include "music.h"

boolean playmusic;

void setup() {
  Serial.begin(9600);
  strip.begin();
  strip.setBrightness(BRIGHT_MAX);
  keyCoin.begin(INPUT);
}

void loop() {

  if (keyCoin.readEvent() == SHORT_PRESS) //检查碰撞开关按下。
    playmusic = !playmusic;

  if (playmusic)         //开始播放音乐。
  {
    if (!playSound(3))   //音乐播放结束
      playmusic = false;
  }
  else                   //关闭音乐。
  {
    playIndex = 0;
    noTone(PIN_BUZZER);
    strip.setAllLED(colorArray[0]);
    strip.show();
  }
  delay(15);
}
